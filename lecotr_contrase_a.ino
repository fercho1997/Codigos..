#include <Keypad.h>     // importa libreria Keypad

#include <Adafruit_Fingerprint.h>

#include <Adafruit_GFX.h>  // Incluir librerias
#include <Adafruit_SSD1306.h>  // Incluir librerias
#include <SPI.h>
#include <Wire.h>

#include <LiquidCrystal_I2C.h>
#include <Servo.h>
Servo controlador; 
Adafruit_SSD1306 display;
SoftwareSerial mySerial(10,11);
int val=0;
int pulsador=12;


Adafruit_Fingerprint finger = Adafruit_Fingerprint(&mySerial);


const byte FILAS = 4;     // define numero de filas
const byte COLUMNAS = 4;    // define numero de columnas
char keys[FILAS][COLUMNAS] = {    // define la distribucion de teclas
  {'1','2','3','A'},
  {'4','5','6','B'},
  {'7','8','9','C'},
  {'*','0','#','D'}
};

byte pinesFilas[FILAS] = {9,8,7,6};   // pines correspondientes a las filas
byte pinesColumnas[COLUMNAS] = {5,4,3,2}; // pines correspondientes a las columnas

Keypad teclado = Keypad(makeKeymap(keys), pinesFilas, pinesColumnas, FILAS, COLUMNAS);  // crea objeto

char TECLA;       // almacena la tecla presionada
char CLAVE[5];        // almacena en un array 6 digitos ingresados
char CLAVE_MAESTRA[5] = "1111";   // almacena en un array la contraseña maestra
byte INDICE = 0;      // indice del array

  bool inicio= false;


  ///////// IMAGEN NUEMRO 1 PUERTA //////////////////////

static const uint8_t ico [] PROGMEM = {
0x00, 0x00, 0x00, 0x00, 0x00, 0x00, 0x00, 0x00, 0x00, 0x00, 0x00, 0x00, 0x00, 0x00, 0x00, 0x00, 
  0x00, 0x00, 0x00, 0x00, 0x00, 0x00, 0x00, 0x00, 0x00, 0x00, 0x00, 0x00, 0x00, 0x00, 0x00, 0x00, 
  0x00, 0x00, 0x00, 0x00, 0x00, 0x00, 0x00, 0x00, 0x00, 0x00, 0x00, 0x00, 0x00, 0x00, 0x00, 0x00, 
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  0x00, 0xfc, 0xf0, 0x00, 0x00, 0x00, 0xe8, 0x00, 0x00, 0x00, 0x00, 0x00, 0x00, 0x00, 0x00, 0x00
};


///////// IMAGEN NUEMRO 2 PUERTA //////////////////////

static const uint8_t icon [] PROGMEM = {
0x00, 0x00, 0x00, 0x00, 0x00, 0x00, 0x00, 0x00, 0x00, 0x00, 0x00, 0x00, 0x00, 0x00, 0x00, 0x00, 
  0x00, 0x00, 0x00, 0x00, 0x00, 0x00, 0x00, 0x00, 0x00, 0x00, 0x00, 0x00, 0x00, 0x00, 0x00, 0x00, 
  0x00, 0x00, 0x00, 0x00, 0x00, 0x00, 0x00, 0x00, 0x00, 0x00, 0x00, 0x00, 0x00, 0x00, 0x00, 0x00, 
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  0x00, 0xfc, 0xf0, 0x00, 0x00, 0x00, 0xc0, 0x00, 0x00, 0x00, 0x00, 0x00, 0x00, 0x00, 0x00, 0x00
};

 
///////// IMAGEN NUEMRO 1 PUERTA //////////////////////

static const uint8_t icono [] PROGMEM = {
0x00, 0x00, 0x00, 0x00, 0x00, 0x00, 0x00, 0x00, 0x00, 0x00, 0x00, 0x00, 0x00, 0x00, 0x00, 0x00, 
  0x00, 0x00, 0x00, 0x00, 0x00, 0x00, 0x00, 0x00, 0x00, 0x00, 0x00, 0x00, 0x00, 0x06, 0x00, 0x00, 
  0x00, 0x00, 0x00, 0x00, 0x00, 0x00, 0x00, 0x00, 0x00, 0x00, 0x00, 0x00, 0x00, 0x00, 0x00, 0x00, 
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  0x00, 0xfc, 0xf0, 0x00, 0x00, 0x00, 0xc0, 0x00, 0x00, 0x00, 0x00, 0x00, 0x00, 0x00, 0x00, 0x00
};

  
///////// IMAGEN NUEMRO 1 PUERTA //////////////////////

static const uint8_t iconos [] PROGMEM = {
  0x00, 0x00, 0x00, 0x00, 0x00, 0x00, 0x00, 0x00, 0x00, 0x00, 0x0f, 0xf1, 0x00, 0x00, 0x00, 0x00, 
  0x00, 0x00, 0x00, 0x00, 0x00, 0x00, 0x00, 0x00, 0x00, 0x00, 0x00, 0x00, 0x00, 0x00, 0x0e, 0x79, 
  0x00, 0x00, 0x00, 0x00, 0x00, 0x00, 0x00, 0x00, 0x00, 0x00, 0x00, 0x00, 0x00, 0x00, 0x00, 0x00, 
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  0x00, 0xfc, 0xf0, 0x00, 0x00, 0x00, 0xc0, 0x00, 0x00, 0x00, 0x00, 0x00, 0x00, 0x00, 0x00, 0x00
};



///////////// IMAGEN DE PROHIBIDO ENTRAR ///////////////// 

static const uint8_t iconosh [] PROGMEM = {
 0x00, 0x00, 0x00, 0x00, 0x00, 0x00, 0x00, 0x00, 0x00, 0x00, 0x00, 0x00, 0x00, 0x00, 0x00, 0x00, 
  0x00, 0x00, 0x00, 0x7f, 0xc0, 0x00, 0x00, 0x00, 0x00, 0x00, 0x01, 0xff, 0xf0, 0x00, 0x00, 0x00, 
  0x00, 0x00, 0x03, 0xf9, 0xfc, 0x00, 0x00, 0x00, 0x00, 0x00, 0x07, 0x80, 0x3e, 0x00, 0x00, 0x00, 
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  0x00, 0x00, 0x00, 0x00, 0x00, 0x00, 0x00, 0x00, 0x00, 0x00, 0x00, 0x00, 0x00, 0x00, 0x00, 0x00
};

void setup()
{
 Serial.begin(9600);      // inicializa comunicacion serie
  delay(100);
  controlador.attach(13);                      // servomotor 
   display.begin(SSD1306_SWITCHCAPVCC, 0x3C); // Inicializar la pantalla con la dirección I2C de 0x3C
  display.clearDisplay();                    // limpiar pantalla
  display.setTextColor(WHITE);               // color
  display.setRotation(0);                    // tamaño de letra
  display.setTextWrap(false);  
  display.dim(0);                            // Establecer brillo (0 es máximo y 1 es un poco tenue)
 
  // set the data rate for the sensor serial port
  finger.begin(57600);

  if (finger.verifyPassword()) {
    Serial.println("Found fingerprint sensor!");
 display.clearDisplay();  ///// limpiar la pantalla oled 
    display.setTextSize(0); ////////////// tamaño de la letra que saldra en la pantalla oled
    display.setCursor(0, 5);  // (x,y) donde saldra el texto 
    display.println(F("Sensor "));  ///// texto 
    display.setCursor(0, 15);  // (x,y)  donde saldra el texto
    display.println(F("Encontrado :) ")); ////  texto
    display.display();  /// para poder imprimir el texto escrito anterior mente 
    inicio=true;
    delay(3000);
    
  } else {
    Serial.println("Did not find fingerprint sensor :(");
    delay(100);
    display.clearDisplay();  // limpiar la pantalla oled 
    display.setTextSize(0);////////////// tamaño de la letra que saldra en la pantalla oled
    display.setCursor(0, 5);  //(x,y) donde saldra el texto 
    display.println(F("Sensor No"));  ///// texto 
    display.setCursor(0, 15);  ////(x,y) donde saldra el texto 
    display.println(F("Encontrado :( ")); /// texto 
    display.display();  /// para poder imprimir el texto escrito anterior mente 
    delay(5000);
    while (1) { delay(1); }
  }
}

void loop(){
  TECLA = teclado.getKey();   // obtiene tecla presionada y asigna a variable
  if (inicio==true){
     Serial.println(" menu");  // imprime en monitor serial que es correcta la clave
   display.clearDisplay();                         // limpiar pantalla
 delay(1000);
  display.setTextSize(0);                         // tamaño de letra
  display.setCursor(0, 0);                        // (x,y)
  display.println(F("Bienvenido :)"));            // palabras que salen en la pantalla oled
   display.setCursor(0, 8);                       // (x,y)
  display.println(F("Esperando Intruccion"));     // palabras que salen en la pantalla oled
  display.setCursor(0, 16);                       // (x,y)
  display.println(F("o Codigo:"));                // palabras que salen en la pantalla oled
 display.display();                               // Imprime todo lo que configuramos previamente
     delay(5000);
  inicio=false;
  }
  if (TECLA!= NO_KEY)        // comprueba que se haya presionado una tecla
  {
    CLAVE[INDICE] = TECLA;    // almacena en array la tecla presionada
    INDICE++;       // incrementa indice en uno
    Serial.print(TECLA);    // envia a monitor serial la tecla presionada
       display.clearDisplay();                 // limpiar pantalla
      display.setTextSize(0);                      // tamaño de letra   
  display.print(TECLA);                        // palabras que salen en la pantalla oled
  display.display();
  }

  if(INDICE == 4)       // si ya se almacenaron los 6 digitos
  {
    if(!strcmp(CLAVE, CLAVE_MAESTRA)) {  // compara clave ingresada con clave maestra
      Serial.println(" Correcta");  // imprime en monitor serial que es correcta la clave
     Serial.println(" Correcta");                // imprime en monitor serial que es correcta la clave
    display.setTextSize(2);                        // tamaño de letra
     display.setCursor(0,5);                       // (x,y)
  display.println("Correcta" );                    // palabras que salen en la pantalla oled
   display.display();                              // Imprime todo lo que configuramos previamente
    delay(2000) ;

    accion_1(); 
    inicio=true;
   }
 else{
      Serial.println(" Incorrecta");  // imprime en monitor serial que es incorrecta la clave

delay(200);
  accion_4();
    INDICE = 0;
    delay(200);
    inicio=true;
  }
  INDICE = 0;
  }
   if(TECLA== 'C')
   {   Serial.println(" cerrar");  // imprime en monitor serial que es incorrecta la clave
    accion_2();
 }               //   cierra la puerta          
  val=digitalRead(12);                            // pulsador                  
if  ((val == HIGH)){                              //  si mi pulsador fue precionado 
      Serial.println(" abrir");  // imprime en monitor serial que es incorrecta la clave
        accion_3();                          // habrir puerta
} 
}

void accion_4(){ 

     display.clearDisplay();                          // limpiar pantalla
   display.setTextSize(3);                            // tamaño de letra
  display.setCursor(70, 5);                          // (x,y)
  display.println("NO");                             // palabras que salen en la pantalla oled
   display.drawBitmap(0,0,iconosh,60,30,WHITE );      // tamaño de la imagen y nombre de la imagen 
  display.display();  
   delay(2000);
}

void accion_1(){ 

    display.clearDisplay();                       // limpiar pantalla
      display.clearDisplay();                        // limpiar pantalla
 display.setTextSize(2);                             // tamaño de letra
  display.setCursor(8,2);                           // (x,y)
  display.println(F("coloca el   "));           // palabras que salen en la pantalla oled
  display.setCursor(10, 17);                         // (x,y)
 display.println(F("  dedo "));             // palabras que salen en la pantalla oled
   display.display();  
    delay(2000);   
  
  
     getFingerprintID();   //7 llama la funcion de reconocimiento de huellas
   delay(2000);   

  inicio=true;            // meregres al menu
  
}



////////////////////////////// abrir puerta //////////////////////////////////
void accion_3(){ 
 
/////////////////////// imagen 1 ////////////////////

 display.clearDisplay();                     // limpiar pantalla
  display.setTextSize(2);                    // tamaño de letra
   display.setCursor(0, 2);                  // (x,y)
   display.println(F("abrir "));             // palabras que salen en la pantalla oled
display.drawBitmap(0,0,ico,160,40,WHITE);    // tamaño de la imagen y nombre de la imagen 
display.display();                           // Imprime todo lo que configuramos previamente
     delay(2000);

     
/////////////////////// imagen 2 ////////////////////

  display.clearDisplay();                      // limpiar pantalla
  display.setTextSize(2);                      // tamaño de letra
   display.setCursor(0, 2);                    // (x,y)
   display.println(F("abrir "));               // palabras que salen en la pantalla oled
display.drawBitmap(0,0,icon,160,40,WHITE);     // tamaño de la imagen y nombre de la imagen 
display.display();                             // Imprime todo lo que configuramos previamente
     delay(2000);

     
/////////////////////// imagen 3 ////////////////////

   display.clearDisplay();                       // limpiar pantalla
  display.setTextSize(2);                        // tamaño de letra
   display.setCursor(0, 2);                      // (x,y)
   display.println(F("abrir "));                 // palabras que salen en la pantalla oled
  display.drawBitmap(0,0,icono,160,40,WHITE);    // tamaño de la imagen y nombre de la imagen 
display.display();                               // Imprime todo lo que configuramos previamente
     delay(2000);


/////////////////////// imagen 4 ////////////////////

     display.clearDisplay();                     // limpiar pantalla
  display.setTextSize(2);                        // tamaño de letra
   display.setCursor(0, 2);                      // (x,y)
   display.println(F("abrir "));                 // palabras que salen en la pantalla oled
display.drawBitmap(0,0,iconos,160,40,WHITE);     // tamaño de la imagen y nombre de la imagen 
display.display();                               // Imprime todo lo que configuramos previamente
    controlador.write(90);                      // colocar servomotor a 90 grados
 
     delay(2000);


  inicio=true;
}





void accion_2(){ 
  

/////////////////////// imagen 4 ////////////////////
                          // colocar servomotor a 90 grados
   display.clearDisplay();                        // limpiar pantalla
  display.setTextSize(2);                         // tamaño de letra
   display.setCursor(0, 2);                       // (x,y)
   display.println(F("Cerrar "));                 // palabras que salen en la pantalla oled
display.drawBitmap(0,0,iconos,160,40,WHITE);      // tamaño de la imagen y nombre de la imagen
display.display();                                // Imprime todo lo que configuramos previamente
     delay(2000);


/////////////////////// imagen 3 ////////////////////
     
      display.clearDisplay();                        // limpiar pantalla
  display.setTextSize(2);                            // tamaño de letra
   display.setCursor(0, 2);                          // (x,y)
   display.println(F("Cerrar "));                    // palabras que salen en la pantalla oled
  display.drawBitmap(0,0,icono,160,40,WHITE);        // tamaño de la imagen y nombre de la imagen
display.display();                                   // Imprime todo lo que configuramos previamente
     delay(2000);


/////////////////////// imagen 2 ////////////////////

      display.clearDisplay();                         // limpiar pantalla
  display.setTextSize(2);                            // tamaño de letra
   display.setCursor(0, 2);                          // (x,y)
   display.println(F("Cerrar "));                    // palabras que salen en la pantalla oled
display.drawBitmap(0,0,icon,160,40,WHITE);           // tamaño de la imagen y nombre de la imagen
display.display();                                   // Imprime todo lo que configuramos previamente
     delay(2000);


/////////////////////// imagen 1 ////////////////////

      display.clearDisplay();                        // // limpiar pantalla
  display.setTextSize(2);                            // tamaño de letra
   display.setCursor(0, 2);                          // (x,y)
   display.println(F("Cerrar "));                    // palabras que salen en la pantalla oled
display.drawBitmap(0,0,ico,160,40,WHITE);            // tamaño de la imagen y nombre de la imagen
display.display(); // Imprime todo lo que configuramos previamente
    controlador.write(0);                           // colocar servomotor a 90 grados
  
     delay(2000);

     
  inicio=true;

}



uint8_t getFingerprintID() {
  uint8_t p = finger.getImage();
  switch (p) {
    case FINGERPRINT_OK:
      Serial.println("Imagen tomada");
      break;
    case FINGERPRINT_NOFINGER:
      Serial.println("No se detecta  ningún dedo");
      return p;
    case FINGERPRINT_PACKETRECIEVEERR:
      Serial.println("Communication error");
      return p;
    case FINGERPRINT_IMAGEFAIL:
      Serial.println("Error de comunicación");
      return p;
    default:
      Serial.println("Unknown error");
      return p;
  }

  // OK success!

  p = finger.image2Tz();
  switch (p) {
    case FINGERPRINT_OK:
      Serial.println("Imagen convertida");
      break;
    case FINGERPRINT_IMAGEMESS:
      Serial.println("Imagen demasiado desordenada");
      return p;
    case FINGERPRINT_PACKETRECIEVEERR:
      Serial.println("Error de comunicación");
      return p;
    case FINGERPRINT_FEATUREFAIL:
      Serial.println("Could not find fingerprint features");
      return p;
    case FINGERPRINT_INVALIDIMAGE:
      Serial.println("Could not find fingerprint features");
      return p;
    default:
      Serial.println("Unknown error");
      return p;
  }

  // OK converted!
  p = finger.fingerSearch();
  if (p == FINGERPRINT_OK) {
    Serial.println("Encontró una coincidencia de impresión!");
   display.clearDisplay();  // Clear the display so we can refresh

    display.setTextSize(0);
    display.setCursor(15, 2);  // (x,y)
    display.println(F("Huella Incontrada "));   /// texto 
    
    display.setTextSize(1);
    display.setCursor(47, 12);  // (x,y)
    display.println(F("N"));   /// texto 
    
    display.setCursor(57, 12);  // (x,y)
    display.println(finger.fingerID);   /// texto 
    display.display();  /// para poder imprimir el texto escrito anterior mente
    controlador.write(90);                                      // colocar servomotor a 90 grados
    delay(5000);
    accion_3();
 delay(200);
    accion_2();
     delay(200);
  } else if (p == FINGERPRINT_PACKETRECIEVEERR) {
    Serial.println("Error de comunicación");
    return p;
  } else if (p == FINGERPRINT_NOTFOUND) {
    Serial.println("No encontré una coincidencia");
       display.clearDisplay();  // Clear the display so we can refresh

    display.setTextSize(0);
    display.setCursor(8, 3);  // (x,y)
    display.println(F(" Retirese Intruso "));   /// texto 
    display.display();  /// para poder imprimir el texto escrito anterior mente
     delay(5000);
     accion_4();
    delay(5000);
 
    return p;
  } else {
    Serial.println("Error desconocido");
    return p;
  }

  // found a match!
  Serial.print("Encontrado ID #"); Serial.print(finger.fingerID);
  Serial.print(" con la confianza de "); Serial.println(finger.confidence);

  return finger.fingerID;
}

// returns -1 if failed, otherwise returns ID #
int getFingerprintIDez() {
  uint8_t p = finger.getImage();
  if (p != FINGERPRINT_OK)  return -1;

  p = finger.image2Tz();
  if (p != FINGERPRINT_OK)  return -1;

  p = finger.fingerFastSearch();
  if (p != FINGERPRINT_OK)  return -1;

  // found a match!
  Serial.print("Encontrado ID #"); Serial.print(finger.fingerID);
  Serial.print(" con la confianza de "); Serial.println(finger.confidence);
  return finger.fingerID;
}
